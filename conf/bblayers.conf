## conf/bblayers.conf
```bitbake
# LAYER_CONF_VERSION is increased each time build/conf/bblayers.conf
# changes incompatibly
LCONF_VERSION = "7"
TOPDIR := "${@os.path.dirname(os.path.dirname(d.getVar('FILE', True)))}"

BBPATH = "${TOPDIR}"

BBFILES = ""

# These layers hold recipe metadata not found in OE-core, but lack any machine or distro content
BASELAYERS ?= " \
  ${TOPDIR}/oe-linux/meta-openembedded/meta-oe \
  ${TOPDIR}/oe-linux/meta-openembedded/meta-xfce \
  ${TOPDIR}/oe-linux/meta-openembedded/meta-initramfs \
  ${TOPDIR}/oe-linux/meta-openembedded/meta-multimedia \
  ${TOPDIR}/oe-linux/meta-openembedded/meta-networking \
  ${TOPDIR}/oe-linux/meta-openembedded/meta-filesystems \
  ${TOPDIR}/oe-linux/meta-openembedded/meta-perl \
  ${TOPDIR}/oe-linux/meta-openembedded/meta-python \
  ${TOPDIR}/oe-linux/meta-qt4 \
  ${TOPDIR}/oe-linux/meta-java \
  ${TOPDIR}/oe-linux/meta-browser \
  ${TOPDIR}/oe-linux/meta-mono \
  ${TOPDIR}/oe-linux/meta-qt5 \
  ${TOPDIR}/oe-linux/meta-kodi \
"

# These layers hold machine specific content, aka Board Support Packages
BSPLAYERS ?= " \
  ${TOPDIR}/oe-linux/meta-ti \
  ${TOPDIR}/oe-linux/meta-freescale \
  ${TOPDIR}/oe-linux/meta-freescale-3rdparty \
  ${TOPDIR}/oe-linux/meta-nslu2 \
  ${TOPDIR}/oe-linux/meta-smartphone/meta-android \
  ${TOPDIR}/oe-linux/meta-smartphone/meta-hp \
  ${TOPDIR}/oe-linux/meta-smartphone/meta-huawei \
  ${TOPDIR}/oe-linux/meta-smartphone/meta-motorola \
  ${TOPDIR}/oe-linux/meta-smartphone/meta-oneplus \
  ${TOPDIR}/oe-linux/meta-smartphone/meta-xiaomi \
  ${TOPDIR}/oe-linux/meta-smartphone/meta-lg \
  ${TOPDIR}/oe-linux/meta-intel \
  ${TOPDIR}/oe-linux/meta-sunxi \
  ${TOPDIR}/oe-linux/meta-chip \
  ${TOPDIR}/oe-linux/meta-raspberrypi \
  ${TOPDIR}/oe-linux/meta-dominion \
  ${TOPDIR}/oe-linux/meta-atmel \
  ${TOPDIR}/oe-linux/meta-amd \
  ${TOPDIR}/oe-linux/meta-edison \
  ${TOPDIR}/oe-linux/meta-galileo \
  ${TOPDIR}/oe-linux/meta-quark \

"

# Add your overlay location to EXTRALAYERS
# Make sure to have a conf/layers.conf in there
EXTRALAYERS ?= " \
  ${TOPDIR}/oe-linux/meta-linaro/meta-linaro-toolchain \
  ${TOPDIR}/oe-linux/meta-linaro/meta-optee \
  ${TOPDIR}/oe-linux/meta-backports \
"

BBLAYERS = " \
  ${TOPDIR}/oe-linux/meta-angstrom \
  ${BASELAYERS} \
  ${BSPLAYERS} \
  ${EXTRALAYERS} \
  ${TOPDIR}/oe-linux/openembedded-core/meta \
"
```
